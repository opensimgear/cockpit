## apps/companion-esp32/boards/sunton-3248s035r/sdkconfig.defaults
```kconfig
CONFIG_ESP_DEFAULT_CPU_FREQ_MHZ_240=y
CONFIG_ESPTOOLPY_FLASHMODE_DIO=y
CONFIG_ESPTOOLPY_FLASHFREQ_40M=y
CONFIG_ESPTOOLPY_FLASHSIZE_4MB=y
CONFIG_SPIRAM=n
CONFIG_ESP_CONSOLE_UART_DEFAULT=y
CONFIG_ESP_CONSOLE_UART_BAUDRATE=115200
CONFIG_FREERTOS_HZ=1000

CONFIG_OSG_SERIAL_BAUD=115200

# New engine installation requires an explicit, verified partition migration.
CONFIG_PARTITION_TABLE_SINGLE_APP_LARGE=n
CONFIG_PARTITION_TABLE_CUSTOM=y
CONFIG_PARTITION_TABLE_CUSTOM_FILENAME="boards/sunton-3248s035r/partitions.csv"
```

## apps/companion-esp32/boards/waveshare-lcd7/sdkconfig.defaults
```kconfig
CONFIG_ESP_DEFAULT_CPU_FREQ_MHZ_240=y
CONFIG_ESPTOOLPY_FLASHMODE_QIO=y
CONFIG_ESPTOOLPY_FLASHFREQ_80M=y
CONFIG_ESPTOOLPY_FLASHSIZE_8MB=y
CONFIG_SPIRAM=y
CONFIG_SPIRAM_MODE_OCT=y
CONFIG_SPIRAM_SPEED_80M=y
CONFIG_SPIRAM_XIP_FROM_PSRAM=y
CONFIG_SPIRAM_MEMTEST=y
CONFIG_ESP32S3_DATA_CACHE_64KB=y
CONFIG_ESP32S3_DATA_CACHE_LINE_64B=y
CONFIG_FREERTOS_HZ=1000
CONFIG_ESP_CONSOLE_UART_DEFAULT=y
CONFIG_ESP_CONSOLE_UART_BAUDRATE=115200
CONFIG_LCD_RGB_ISR_IRAM_SAFE=n

# New engine installation requires an explicit, verified partition migration.
CONFIG_PARTITION_TABLE_SINGLE_APP_LARGE=n
CONFIG_PARTITION_TABLE_CUSTOM=y
CONFIG_PARTITION_TABLE_CUSTOM_FILENAME="boards/waveshare-lcd7/partitions.csv"
```

## apps/companion-esp32/main/Kconfig.projbuild
```kconfig
menu "OpenSimGear companion (offline firmware foundation)"
config OSG_SERIAL_BAUD
    int "USB serial baud rate"
    range 115200 921600
    default 921600
config OSG_SCREEN_WIDTH
    int "Headless screen width"
    range 64 4096
    default 800
config OSG_SCREEN_HEIGHT
    int "Headless screen height"
    range 64 4096
    default 480
config OSG_SUNTON_X_MIN
    int "Sunton touch raw X min"
    range 0 4094
    default 200
config OSG_SUNTON_X_MAX
    int "Sunton touch raw X max"
    range 1 4095
    default 3900
config OSG_SUNTON_Y_MIN
    int "Sunton touch raw Y min"
    range 0 4094
    default 200
config OSG_SUNTON_Y_MAX
    int "Sunton touch raw Y max"
    range 1 4095
    default 3900
endmenu
```

## apps/companion-esp32/sdkconfig.defaults
```kconfig
CONFIG_COMPILER_OPTIMIZATION_SIZE=y
CONFIG_ESPTOOLPY_FLASHSIZE_4MB=y
CONFIG_ESP_MAIN_TASK_STACK_SIZE=8192
CONFIG_WS_TRANSPORT=y
CONFIG_MBEDTLS_CERTIFICATE_BUNDLE=n
CONFIG_PARTITION_TABLE_CUSTOM=y
CONFIG_PARTITION_TABLE_CUSTOM_FILENAME="partitions.csv"
```
